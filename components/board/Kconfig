## components/board/Kconfig
```kconfig
menu "CyberDeck board"

    config HAL_BACKLIGHT_PWM_GPIO
        int "Backlight PWM GPIO (-1 to disable, use CH422G EXIO2 binary)"
        range -1 48
        default -1
        help
            GPIO number wired to a PWM-capable backlight driver. When set
            to a valid pin (0..48) the board HAL programs LEDC at 5 kHz /
            10-bit and modulates duty proportional to the level passed to
            hal_backlight_set_level. When -1 the BL line stays on the
            CH422G EXIO2 expander (Waveshare ESP32-S3-Touch-LCD-4.3 stock
            wiring) and dimming quantises to off (<=0.01) / on (>0.01).

    config HAL_BACKLIGHT_PWM_FREQ_HZ
        int "Backlight PWM frequency (Hz)"
        depends on HAL_BACKLIGHT_PWM_GPIO >= 0
        range 200 40000
        default 5000

endmenu
```

## components/deck_sdi/Kconfig
```kconfig
menu "Deck SDI"

config DECK_SDI_SELFTEST
    bool "Run SDI driver selftests at boot"
    default y
    help
        If enabled, main runs each registered driver's selftest after
        registration. Useful during development to catch driver
        regressions early; disable for smaller images / faster boot on
        release builds.

endmenu
```

## main/Kconfig.projbuild
```kconfig
menu "CyberDeck Configuration"

    # Populated as DL1 components land (deck_sdi, deck_runtime, deck_shell).

endmenu
```

## sdkconfig.defaults
```kconfig
# S3 Cyber-Deck by Diana Nerd
# Target: Waveshare ESP32-S3-Touch-LCD-4.3
# DL1 bootstrap baseline — WiFi/LVGL/HTTP configs re-added as later phases land.

CONFIG_IDF_TARGET="esp32s3"

# CPU
CONFIG_ESP_DEFAULT_CPU_FREQ_MHZ_240=y

# Flash
CONFIG_ESPTOOLPY_FLASHMODE_QIO=y
CONFIG_ESPTOOLPY_FLASHFREQ_80M=y
CONFIG_ESPTOOLPY_FLASHSIZE_8MB=y

# PSRAM (octal on CyberDeck)
CONFIG_SPIRAM=y
CONFIG_SPIRAM_MODE_OCT=y
CONFIG_SPIRAM_SPEED_80M=y
CONFIG_SPIRAM_MALLOC_ALWAYSINTERNAL=4096
CONFIG_SPIRAM_MALLOC_RESERVE_INTERNAL=65536

# Cache
CONFIG_ESP32S3_DATA_CACHE_LINE_64B=y

# FreeRTOS
CONFIG_FREERTOS_HZ=1000

# Partition table
CONFIG_PARTITION_TABLE_CUSTOM=y
CONFIG_PARTITION_TABLE_CUSTOM_FILENAME="partitions.csv"

# USB Serial/JTAG console (secondary, for debug over USB native port)
CONFIG_ESP_CONSOLE_SECONDARY_USB_SERIAL_JTAG=y

# SPIFFS — bump object name len from default 32 so conformance paths fit.
# The bundled .deck tests live under /conformance/* with descriptive names.
CONFIG_SPIFFS_OBJ_NAME_LEN=64

# Main task stack: 3584 bytes is tight for the DL1 conformance harness,
# which on top of the runtime + SPIFFS + log-capture hook also runs a
# concurrent-logging stress test. DL2 F21.1 user-defined `fn` + non-tail
# recursion: `fib(15)` in lang.fn.recursion chains 15 Deck levels, each
# ≈ 750-900 bytes of C stack (deck_interp_run 160 + run_call 192 +
# invoke_user_fn 80 + body 160 + binop 160), so ~13 KB peak for the
# interp chain, plus conformance harness capture buffers and pre-deck
# shell/SDI bookkeeping stacked beneath. 16 KB tripped the FreeRTOS
# stack canary and rebooted the board; 24 KB gives ~8 KB headroom over
# the observed peak. The +8 KB comes out of internal SRAM so the
# memory.heap_idle_budget stress canary (64 KB ceiling, leak detector
# not spec requirement — comment in s_heap_idle_budget) sees ~56 KB,
# still comfortably above runaway-leak territory. Concept #68 (2026-04-20).
CONFIG_ESP_MAIN_TASK_STACK_SIZE=24576

# UI fonts — CYBERDECK_FONT_SM/MD/LG/XL aliases (CLAUDE.md UI design system).
CONFIG_LV_FONT_MONTSERRAT_18=y
CONFIG_LV_FONT_MONTSERRAT_24=y
CONFIG_LV_FONT_MONTSERRAT_32=y
CONFIG_LV_FONT_MONTSERRAT_40=y

# Conformance suite — runs 79 deck tests + 15 stress tests at boot
# (~25s). Disabled by default so the lockscreen appears promptly. Flip
# back to =y in menuconfig for hardware verification flows.
CONFIG_DECK_SDI_SELFTEST=n
```
